## components/kaleido_speech/Kconfig
```kconfig
menu "kaleido_speech"

choice KS_TTS_PROVIDER
	prompt "TTS provider"
	default KS_TTS_PROVIDER_MINIMAX
	config KS_TTS_PROVIDER_DASHSCOPE
		bool "DashScope cosyvoice (WS)"
	config KS_TTS_PROVIDER_MINIMAX
		bool "MiniMax t2a_v2 (HTTPS SSE)"
endchoice

config KS_TTS_MM_MODEL
	string "MiniMax TTS model"
	default "speech-2.5-hd-preview"
config KS_TTS_MM_VOICE
	string "MiniMax voice id"
	default "female-tianmei"
config KS_MM_KEY
	string "MiniMax API key (JWT)"
	default ""

endmenu
```

## kaleido-fw/tools/hil/convo-stage/sdkconfig.defaults
```kconfig
# convo-stage：V-45 舞台×语音联动（voice-loop-p4 ∪ dsi-lvgl 配置并集）
CONFIG_IDF_TARGET="esp32p4"
CONFIG_ESP_DEFAULT_CPU_FREQ_MHZ_400=y
CONFIG_COMPILER_OPTIMIZATION_PERF=y
CONFIG_SPIRAM=y
CONFIG_SPIRAM_SPEED_200M=y
CONFIG_SPIRAM_USE_MALLOC=y
CONFIG_SPIRAM_MALLOC_ALWAYSINTERNAL=0
# 8192：64B 行吃掉大量内部 tag RAM，合并应用需回收预留池空间
#（hosted 池在 PSRAM、I2S DMA 先于一切分配，32K 预留职责已被替代）
CONFIG_SPIRAM_MALLOC_RESERVE_INTERNAL=8192
# 显示性能基线（osptek 例程同款）
CONFIG_CACHE_L2_CACHE_256KB=y
# 64B：esp_hosted PSRAM mempool 与 128B 行组合使 TX 缓冲半数非法
#（esp-hosted-mcu #219 确认修，实测 64B 下合并应用可完整启动）
CONFIG_CACHE_L2_CACHE_LINE_64B=y
# 本板烧写与 flash 基线（V-38 勘误口径：通用驱动+QIO 即稳）
CONFIG_ESPTOOLPY_FLASHMODE_QIO=y
CONFIG_ESPTOOLPY_FLASHFREQ_80M=y
CONFIG_ESPTOOLPY_FLASHSIZE_16MB=y
CONFIG_SPI_FLASH_SUPPORT_BOYA_CHIP=y
CONFIG_ESPTOOLPY_NO_STUB=y
CONFIG_PARTITION_TABLE_CUSTOM=y
CONFIG_PARTITION_TABLE_CUSTOM_FILENAME="partitions.csv"
CONFIG_PARTITION_TABLE_OFFSET=0x10000
CONFIG_ESP_CONSOLE_UART_DEFAULT=y
CONFIG_FREERTOS_HZ=1000
CONFIG_ESP_MAIN_TASK_STACK_SIZE=16384
# W-4：国内云 NLB 需 TLS1.3；WDT 口径同两侧 HIL
CONFIG_MBEDTLS_SSL_PROTO_TLS1_3=y
# 缺陷 L：TWDT 开+panic——prio-6 任务死循环曾仅打印不恢复，产品哑了
# 十分钟；楔死必须 5s 级转储+自愈重启（sdkconfig 就地双写）
CONFIG_ESP_TASK_WDT_EN=y
CONFIG_ESP_TASK_WDT_PANIC=y
CONFIG_ESP_TASK_WDT_TIMEOUT_S=7
CONFIG_ESP_INT_WDT_TIMEOUT_MS=3000
# --- WiFi over C5（esp_hosted 3.0.10；slot1/4bit/40MHz/reset54=P4 默认）---
# 缺陷 H 终局：3.x 仍是构造器早启（prio23 任务抢在 app_main 前
# eh_host_init），官方开关关掉，app_main 显式 esp_hosted_init() 保序
CONFIG_ESP_HOSTED_AUTO_CALL_INIT_BEFORE_APP_MAIN=n
CONFIG_LWIP_TCP_SACK_OUT=y
# --- WakeNet ---
CONFIG_SR_WN_WN9_NIHAOXIAOZHI_TTS=y
# --- LVGL（dsi-lvgl 口径）---
CONFIG_LV_COLOR_DEPTH_16=y
CONFIG_LV_DEF_REFR_PERIOD=15
CONFIG_LV_DRAW_SW_DRAW_UNIT_CNT=1
CONFIG_LV_USE_CLIB_MALLOC=y
CONFIG_LV_FONT_MONTSERRAT_12=y
CONFIG_LV_FONT_MONTSERRAT_14=y
CONFIG_LV_FONT_MONTSERRAT_16=y
CONFIG_LV_FONT_MONTSERRAT_18=y
CONFIG_LV_FONT_MONTSERRAT_48=y
# LV_USE_OS 与 esp_lvgl_port 信号机制不匹配（tick 通知死等）：关掉
CONFIG_LV_USE_PERF_MONITOR=y
CONFIG_FREERTOS_USE_TRACE_FACILITY=y
# panic 处理器驻 IRAM：'W' 族硬锁死不吐转储的取证前提（V-45）
CONFIG_ESP_PANIC_HANDLER_IRAM=y
# 运行时统计（'u' 键 vTaskGetRunTimeStats）
CONFIG_FREERTOS_GENERATE_RUN_TIME_STATS=y

# V-45：大音频缓冲迁 PSRAM（EXT_RAM_BSS_ATTR），给 LVGL/I2S DMA/TLS 腾内部 RAM
CONFIG_SPIRAM_ALLOW_BSS_SEG_EXTERNAL_MEMORY=y

# V-45：舞台由单一 pthread 同步驱动（draw+sync 串行），关闭 thorvg 内部线程池（省 ~200KB 内部 RAM）

# ---- KF 崩溃取证包（V-45R）：panic/WDT 转储落 flash coredump 分区 ----
CONFIG_ESP_COREDUMP_ENABLE=y
CONFIG_ESP_COREDUMP_ENABLE_TO_FLASH=y
CONFIG_ESP_COREDUMP_DATA_FORMAT_ELF=y
CONFIG_ESP_COREDUMP_CHECKSUM_CRC32=y
CONFIG_ESP_COREDUMP_MAX_TASKS_NUM=16
CONFIG_ESP_COREDUMP_STACK_SIZE=2048

CONFIG_ESP_SYSTEM_USE_FRAME_POINTER=y

# V-46c：mbedtls 缓冲迁 PSRAM（驻留 AFE 后内部水位线）
CONFIG_MBEDTLS_EXTERNAL_MEM_ALLOC=y

CONFIG_FREERTOS_CHECK_STACKOVERFLOW_CANARY=y
CONFIG_MBEDTLS_CERTIFICATE_BUNDLE_DEFAULT_FULL=y
```

## kaleido-fw/tools/hil/emotion-test/sdkconfig.defaults
```kconfig
CONFIG_IDF_TARGET="esp32s31"
CONFIG_ESPTOOLPY_FLASHSIZE_16MB=y
CONFIG_ESPTOOLPY_FLASHMODE_DIO=y
CONFIG_ESPTOOLPY_FLASHFREQ_80M=y
CONFIG_ESP_TASK_WDT_EN=n
```

## kaleido-fw/tools/hil/voice-loop-p4/sdkconfig.defaults
```kconfig
# voice-loop-p4 HIL：百炼全链延迟实测（osptek P4C5，D-8 平台切换版）
CONFIG_IDF_TARGET="esp32p4"
CONFIG_ESPTOOLPY_FLASHSIZE_16MB=y
CONFIG_PARTITION_TABLE_CUSTOM=y
CONFIG_PARTITION_TABLE_CUSTOM_FILENAME="partitions.csv"
CONFIG_PARTITION_TABLE_OFFSET=0x10000
CONFIG_ESP_DEFAULT_CPU_FREQ_MHZ_400=y
CONFIG_SPIRAM=y
CONFIG_SPIRAM_USE_MALLOC=y
CONFIG_SPIRAM_MALLOC_ALWAYSINTERNAL=0
CONFIG_SPIRAM_MALLOC_RESERVE_INTERNAL=32768
# W-4：国内云 NLB 需 TLS1.3（M1 实证）
CONFIG_MBEDTLS_SSL_PROTO_TLS1_3=y
CONFIG_ESP_TASK_WDT_EN=n
CONFIG_FREERTOS_HZ=1000
CONFIG_ESP_MAIN_TASK_STACK_SIZE=16384
# 本板实测（V-38 勘误口径）：Boya 16MB QIO@80MHz 通用驱动即稳；
# no-stub 走 ROM 模式（stub 起不来）；B-2 挂死真因为 XIP-from-PSRAM
CONFIG_ESPTOOLPY_FLASHMODE_QIO=y
CONFIG_ESPTOOLPY_FLASHFREQ_80M=y
CONFIG_SPI_FLASH_SUPPORT_BOYA_CHIP=y
CONFIG_ESPTOOLPY_NO_STUB=y
CONFIG_ESP_CONSOLE_UART_DEFAULT=y
# --- WiFi over C5（esp_hosted 2.12.9，26 号 §2）---
CONFIG_SLAVE_IDF_TARGET_ESP32C5=y
CONFIG_ESP_HOSTED_CP_TARGET_ESP32C5=y
CONFIG_ESP_HOSTED_SDIO_HOST_INTERFACE=y
CONFIG_ESP_HOSTED_SDIO_SLOT_1=y
CONFIG_ESP_HOSTED_SDIO_4_BIT_BUS=y
# SDIO 引脚用 P4 无预设默认值，恰=核心板实测走线：
# CLK=18 CMD=19 D0=14 D1=15 D2=16 D3=17、复位=GPIO54（手册 p10 + esp_hosted 默认双验证）

# 网络调优回退：streaming 模式下大窗口引发 sdio_rx_get_buffer 对齐分配断言
#（sdio_drv.c:953，内部堆碎片化；MAX_SIZE 预分配模式在 2.12.9 启动即断言）。
# 回默认配置保稳定，提速改由 TTS 预热/连接复用承担，专项浸泡后再引入。
CONFIG_LWIP_TCP_SACK_OUT=y
# esp_hosted 缓冲池优先 PSRAM（需 64B 缓存行，见上）
CONFIG_ESP_HOSTED_MEMPOOL_PREFER_SPIRAM=y
CONFIG_SR_WN_WN9_NIHAOXIAOZHI_TTS=y
```

## kaleido-fw/tools/hil/voice-loop/sdkconfig.defaults
```kconfig
# voice-loop HIL：百炼全链延迟实测（唤醒省略，串口触发采集）
CONFIG_IDF_TARGET="esp32s31"
CONFIG_ESPTOOLPY_FLASHSIZE_16MB=y
CONFIG_PARTITION_TABLE_CUSTOM=y
CONFIG_PARTITION_TABLE_CUSTOM_FILENAME="partitions.csv"
CONFIG_ESP_DEFAULT_CPU_FREQ_MHZ_320=y
CONFIG_SPIRAM=y
CONFIG_SPIRAM_MODE_OCT=y
CONFIG_SPIRAM_SPEED_80M=y
CONFIG_SPIRAM_USE_MALLOC=y
CONFIG_SPIRAM_MALLOC_ALWAYSINTERNAL=0
CONFIG_SPIRAM_MALLOC_RESERVE_INTERNAL=32768
# W-4：国内云 NLB 需 TLS1.3（M1 实证）
CONFIG_MBEDTLS_SSL_PROTO_TLS1_3=y
CONFIG_ESP_TASK_WDT_EN=n
CONFIG_FREERTOS_HZ=1000
CONFIG_ESP_MAIN_TASK_STACK_SIZE=8192
# 唤醒链不用：省模型分区
CONFIG_ESPTOOLPY_FLASHMODE_DIO=y
CONFIG_ESPTOOLPY_FLASHFREQ_80M=y
```

## tools/hil/convo-stage/main/Kconfig.projbuild
```kconfig
menu "voice-loop HIL"

config VL_WIFI_SSID
	string "WiFi SSID"
	default ""

config VL_WIFI_PASS
	string "WiFi password"
	default ""

config VL_DS_KEY
	string "DashScope API key"
	default ""

config VL_LLM_KEY
	string "LLM API key (compatible-mode, may equal DS key)"
	default ""

endmenu
```

## tools/hil/convo-stage/sdkconfig.defaults
```kconfig
# convo-stage：V-45 舞台×语音联动（voice-loop-p4 ∪ dsi-lvgl 配置并集）
CONFIG_IDF_TARGET="esp32p4"
CONFIG_ESP_DEFAULT_CPU_FREQ_MHZ_400=y
CONFIG_COMPILER_OPTIMIZATION_PERF=y
CONFIG_SPIRAM=y
CONFIG_SPIRAM_SPEED_200M=y
CONFIG_SPIRAM_USE_MALLOC=y
CONFIG_SPIRAM_MALLOC_ALWAYSINTERNAL=0
# 8192：64B 行吃掉大量内部 tag RAM，合并应用需回收预留池空间
#（hosted 池在 PSRAM、I2S DMA 先于一切分配，32K 预留职责已被替代）
CONFIG_SPIRAM_MALLOC_RESERVE_INTERNAL=8192
# 显示性能基线（osptek 例程同款）
CONFIG_CACHE_L2_CACHE_256KB=y
# 64B：esp_hosted PSRAM mempool 与 128B 行组合使 TX 缓冲半数非法
#（esp-hosted-mcu #219 确认修，实测 64B 下合并应用可完整启动）
CONFIG_CACHE_L2_CACHE_LINE_64B=y
# 本板烧写与 flash 基线（V-38 勘误口径：通用驱动+QIO 即稳）
CONFIG_ESPTOOLPY_FLASHMODE_QIO=y
CONFIG_ESPTOOLPY_FLASHFREQ_80M=y
CONFIG_ESPTOOLPY_FLASHSIZE_16MB=y
CONFIG_SPI_FLASH_SUPPORT_BOYA_CHIP=y
CONFIG_ESPTOOLPY_NO_STUB=y
CONFIG_PARTITION_TABLE_CUSTOM=y
CONFIG_PARTITION_TABLE_CUSTOM_FILENAME="partitions.csv"
CONFIG_PARTITION_TABLE_OFFSET=0x10000
CONFIG_ESP_CONSOLE_UART_DEFAULT=y
CONFIG_FREERTOS_HZ=1000
CONFIG_ESP_MAIN_TASK_STACK_SIZE=16384
# W-4：国内云 NLB 需 TLS1.3；WDT 口径同两侧 HIL
CONFIG_MBEDTLS_SSL_PROTO_TLS1_3=y
CONFIG_ESP_TASK_WDT_EN=n
CONFIG_ESP_INT_WDT_TIMEOUT_MS=3000
# --- WiFi over C5（esp_hosted 2.12.9）---
CONFIG_SLAVE_IDF_TARGET_ESP32C5=y
CONFIG_ESP_HOSTED_CP_TARGET_ESP32C5=y
CONFIG_ESP_HOSTED_SDIO_HOST_INTERFACE=y
CONFIG_ESP_HOSTED_SDIO_SLOT_1=y
CONFIG_ESP_HOSTED_SDIO_4_BIT_BUS=y
CONFIG_LWIP_TCP_SACK_OUT=y
CONFIG_ESP_HOSTED_MEMPOOL_PREFER_SPIRAM=y
# --- WakeNet ---
CONFIG_SR_WN_WN9_NIHAOXIAOZHI_TTS=y
# --- LVGL（dsi-lvgl 口径）---
CONFIG_LV_COLOR_DEPTH_16=y
CONFIG_LV_DEF_REFR_PERIOD=15
CONFIG_LV_DRAW_SW_DRAW_UNIT_CNT=1
CONFIG_LV_USE_CLIB_MALLOC=y
CONFIG_LV_FONT_MONTSERRAT_12=y
CONFIG_LV_FONT_MONTSERRAT_14=y
CONFIG_LV_FONT_MONTSERRAT_16=y
CONFIG_LV_FONT_MONTSERRAT_18=y
CONFIG_LV_FONT_MONTSERRAT_48=y
# LV_USE_OS 与 esp_lvgl_port 信号机制不匹配（tick 通知死等）：关掉
CONFIG_LV_USE_PERF_MONITOR=y
CONFIG_FREERTOS_USE_TRACE_FACILITY=y
# panic 处理器驻 IRAM：'W' 族硬锁死不吐转储的取证前提（V-45）
CONFIG_ESP_PANIC_HANDLER_IRAM=y
# 运行时统计（'u' 键 vTaskGetRunTimeStats）
CONFIG_FREERTOS_GENERATE_RUN_TIME_STATS=y

# V-45：大音频缓冲迁 PSRAM（EXT_RAM_BSS_ATTR），给 LVGL/I2S DMA/TLS 腾内部 RAM
CONFIG_SPIRAM_ALLOW_BSS_SEG_EXTERNAL_MEMORY=y

# V-45：舞台由单一 pthread 同步驱动（draw+sync 串行），关闭 thorvg 内部线程池（省 ~200KB 内部 RAM）

# ---- KF 崩溃取证包（V-45R）：panic/WDT 转储落 flash coredump 分区 ----
CONFIG_ESP_COREDUMP_ENABLE=y
CONFIG_ESP_COREDUMP_ENABLE_TO_FLASH=y
CONFIG_ESP_COREDUMP_DATA_FORMAT_ELF=y
CONFIG_ESP_COREDUMP_CHECKSUM_CRC32=y
CONFIG_ESP_COREDUMP_MAX_TASKS_NUM=16
CONFIG_ESP_COREDUMP_STACK_SIZE=2048

CONFIG_ESP_SYSTEM_USE_FRAME_POINTER=y

# V-46c：mbedtls 缓冲迁 PSRAM（驻留 AFE 后内部水位线）
CONFIG_MBEDTLS_EXTERNAL_MEM_ALLOC=y

CONFIG_FREERTOS_CHECK_STACKOVERFLOW_CANARY=y
```

## tools/hil/dsi-lvgl/sdkconfig.defaults
```kconfig
# dsi-lvgl：osptek 10.1" JD9366 点屏 + LVGL（原厂例程移植，我们的板级基线）
CONFIG_IDF_TARGET="esp32p4"
CONFIG_ESP_DEFAULT_CPU_FREQ_MHZ_400=y
CONFIG_SPIRAM=y
CONFIG_SPIRAM_SPEED_200M=y
# 显示性能基线（osptek 例程同款）；XIP 先关（B-2 挂死未结案，显示链不依赖）
CONFIG_CACHE_L2_CACHE_256KB=y
CONFIG_CACHE_L2_CACHE_LINE_128B=y
CONFIG_COMPILER_OPTIMIZATION_PERF=y
# 本板烧写与 flash 基线（V-38：Boya 专用驱动 + ROM 模式）
CONFIG_ESPTOOLPY_FLASHMODE_QIO=y
CONFIG_ESPTOOLPY_FLASHSIZE_16MB=y
CONFIG_SPI_FLASH_SUPPORT_BOYA_CHIP=y
CONFIG_ESPTOOLPY_NO_STUB=y
CONFIG_PARTITION_TABLE_CUSTOM=y
CONFIG_PARTITION_TABLE_CUSTOM_FILENAME="partitions.csv"
CONFIG_PARTITION_TABLE_OFFSET=0x10000
CONFIG_ESP_CONSOLE_UART_DEFAULT=y
CONFIG_FREERTOS_HZ=1000
# LVGL（osptek 例程口径 + demo 补齐）
CONFIG_LV_COLOR_DEPTH_16=y
CONFIG_LV_DEF_REFR_PERIOD=15
CONFIG_LV_DRAW_SW_DRAW_UNIT_CNT=1
CONFIG_LV_USE_CLIB_MALLOC=y
CONFIG_LV_FONT_MONTSERRAT_12=y
CONFIG_LV_FONT_MONTSERRAT_14=y
CONFIG_LV_FONT_MONTSERRAT_16=y
CONFIG_LV_FONT_MONTSERRAT_18=y
CONFIG_LV_USE_DEMO_WIDGETS=y
CONFIG_LV_USE_DEMO_BENCHMARK=y
# LV_USE_OS 与 esp_lvgl_port 信号机制不匹配（tick 通知死等）：关掉，渲染单元降 1
# 基准观测：benchmark 结果走串口；屏上叠加 FPS/CPU 监视器
#CONFIG_LV_USE_LOG=y
#CONFIG_LV_LOG_PRINTF=y
CONFIG_LV_USE_PERF_MONITOR=y
# 跑分负载下渲染任务可能长占 CPU：放宽双看门狗（正式固件再议）
CONFIG_ESP_TASK_WDT_EN=n
CONFIG_ESP_INT_WDT_TIMEOUT_MS=3000
```

## tools/hil/wakenet-korvo1/sdkconfig.defaults
```kconfig
CONFIG_SR_WN_WN10_HILEXIN_INT16=y
CONFIG_MODEL_IN_FLASH=y
CONFIG_ESPTOOLPY_FLASHSIZE_16MB=y
CONFIG_PARTITION_TABLE_CUSTOM=y
CONFIG_PARTITION_TABLE_CUSTOM_FILENAME="partitions.csv"
CONFIG_SPIRAM=y
CONFIG_SPIRAM_MODE_OCT=y
CONFIG_SPIRAM_SPEED_80M=y
CONFIG_SPIRAM_USE_MALLOC=y
CONFIG_SPIRAM_MALLOC_ALWAYSINTERNAL=0
CONFIG_SPIRAM_TRY_ALLOCATE_WIFI_LWIP=y
```
